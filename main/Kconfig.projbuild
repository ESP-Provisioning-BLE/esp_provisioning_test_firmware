## main/Kconfig.projbuild
```kconfig
menu "Example Configuration"

    # NOTE: this menu is inherited from the upstream ESP-IDF example
    # examples/provisioning/wifi_prov_mgr so that app_main.c keeps compiling
    # against the same CONFIG_EXAMPLE_* symbols. Its only divergence from
    # upstream is the EXAMPLE_PROV_SECURITY_VERSION_0 entry, which upstream
    # does not offer. The defaults that matter for this test firmware (BLE
    # transport, Security version 1) are pinned in sdkconfig.defaults, not
    # here. Test-firmware-specific options live in the separate "Test firmware
    # features" menu below.

    choice EXAMPLE_PROV_TRANSPORT
        bool "Provisioning Transport"
        default EXAMPLE_PROV_TRANSPORT_SOFTAP if IDF_TARGET_ESP32S2
        default EXAMPLE_PROV_TRANSPORT_BLE
        help
            Wi-Fi provisioning component offers both, SoftAP and BLE transports. Choose any one.

        config EXAMPLE_PROV_TRANSPORT_BLE
            bool "BLE"
            select BT_ENABLED
            depends on !IDF_TARGET_ESP32S2
        config EXAMPLE_PROV_TRANSPORT_SOFTAP
            bool "Soft AP"
            select LWIP_IPV4
    endchoice

    choice EXAMPLE_PROV_SECURITY_VERSION
        bool "Protocomm security version"
        default EXAMPLE_PROV_SECURITY_VERSION_2
        help
            Wi-Fi provisioning component offers 3 security versions.
            The example offers a choice between security version 1 and 2.
            This test firmware also offers security version 0.

        config EXAMPLE_PROV_SECURITY_VERSION_0
            bool "Security version 0 (no security, test only)"
            select ESP_PROTOCOMM_SUPPORT_SECURITY_VERSION_0
            help
                Plain-text provisioning: no key exchange, no proof-of-possession
                and no encryption. Never use it outside testing.

                The upstream example only offers security versions 1 and 2;
                this test firmware adds version 0 to exercise Security0 in
                esp_provisioning_ble (PR #31):
                https://github.com/ESP-Provisioning-BLE/esp_provisioning_ble/pull/31

        config EXAMPLE_PROV_SECURITY_VERSION_1
            bool "Security version 1"
            select ESP_PROTOCOMM_SUPPORT_SECURITY_VERSION_1

        config EXAMPLE_PROV_SECURITY_VERSION_2
            bool "Security version 2"
            select ESP_PROTOCOMM_SUPPORT_SECURITY_VERSION_2
    endchoice

    choice EXAMPLE_PROV_MODE
        bool "Security version 2 mode"
        depends on EXAMPLE_PROV_SECURITY_VERSION_2
        default EXAMPLE_PROV_SEC2_DEV_MODE

        config EXAMPLE_PROV_SEC2_DEV_MODE
            bool "Security version 2 development mode"
            depends on EXAMPLE_PROV_SECURITY_VERSION_2
            help
                This enables the development mode for
                security version 2.
                Please note that this mode is NOT recommended for production purpose.

        config EXAMPLE_PROV_SEC2_PROD_MODE
            bool "Security version 2 production mode"
            depends on EXAMPLE_PROV_SECURITY_VERSION_2
            help
                This enables the production mode for
                security version 2.
    endchoice

    config EXAMPLE_PROV_TRANSPORT
        int
        default 1 if EXAMPLE_PROV_TRANSPORT_BLE
        default 2 if EXAMPLE_PROV_TRANSPORT_SOFTAP

    config EXAMPLE_PROV_ENABLE_APP_CALLBACK
        bool "Enable provisioning manager app callback"
        default n
        help
            This is for advanced use-cases like modifying Wi-Fi configuration parameters. This
            executes a blocking app callback when any provisioning event is triggered.

    config EXAMPLE_RESET_PROVISIONED
        bool
        default n
        prompt "Reset provisioned status of the device"
        help
            This erases the NVS to reset provisioned status of the device on every reboot.
            Provisioned status is determined by the Wi-Fi STA configuration, saved on the NVS.

    config EXAMPLE_RESET_PROV_MGR_ON_FAILURE
        bool
        default y
        prompt "Reset provisioned credentials and state machine after session failure"
        help
            Enable resetting provisioned credentials and state machine after session failure.
            This will restart the provisioning service after retries are exhausted.

    config EXAMPLE_PROV_MGR_CONNECTION_CNT
        int
        default 5
        prompt "Max connection attempts before resetting provisioning state machine"
        depends on EXAMPLE_RESET_PROV_MGR_ON_FAILURE
        help
            Set the total number of connection attempts to avoid reconnecting to an inexistent AP or if credentials
            are misconfigured. Provisioned credentials are erased and internal state machine
            is reset after this threshold is reached.

    config EXAMPLE_PROV_SHOW_QR
        bool "Show provisioning QR code"
        default y
        help
            Show the QR code for provisioning.

    config EXAMPLE_PROV_USING_BLUEDROID
        bool
        depends on (BT_BLUEDROID_ENABLED && (IDF_TARGET_ESP32C3 || IDF_TARGET_ESP32S3))
        select BT_BLE_42_FEATURES_SUPPORTED
        default y
        help
            This enables BLE 4.2 features for Bluedroid.

    config EXAMPLE_REPROVISIONING
        bool "Re-provisioning"
        help
            Enable re-provisioning - allow the device to provision for new credentials
            after previous successful provisioning.

endmenu

menu "Test firmware features (esp_provisioning_ble)"

    comment "Convention: one CONFIG_TESTFW_<NAME> per behaviour under test."
    comment "Each option's help links the package issue/PR that motivates it."

    config TESTFW_APPLY_BSSID
        bool "Honour BSSID/channel from the provisioning SetConfig request"
        default y
        help
            When enabled, the firmware applies the BSSID (and channel) that the
            provisioning client sends in the SetConfig request: it copies the six
            BSSID bytes into wifi_config_t.sta.bssid and sets bssid_set = true, so
            the ESP32 associates with the specific access point requested instead
            of any AP that happens to share the SSID.

            Why this option exists: upstream ESP-IDF's wifi_provisioning component
            receives and length-validates the BSSID
            (components/wifi_provisioning/src/wifi_config.c) but its
            set_config_handler (src/handlers.c) never copies it into the STA
            configuration. As a result, on the stock example (and on any firmware
            that has not patched this) a client-supplied BSSID is silently
            ignored. Turn this option OFF to reproduce that stock behaviour.

            Motivated by esp_provisioning_ble#15 (BSSID support in WifiAP):
            https://github.com/ESP-Provisioning-BLE/esp_provisioning_ble/pull/15

endmenu
```
